## config/west.yml
```yaml
manifest:
  remotes:
    - name: petejohanson
      url-base: https://github.com/petejohanson
  projects:
    - name: zmk
      remote: petejohanson
      revision: shields/splitkb-aurora-sofle
      import: app/west.yml
  self:
    path: config
```
